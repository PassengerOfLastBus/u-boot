## board/freescale/p1_p2_rdb/Kconfig
```kconfig
if TARGET_P1_P2_RDB

config SYS_BOARD
	default "p1_p2_rdb"

config SYS_VENDOR
	default "freescale"

config SYS_CONFIG_NAME
	default "p1_p2_rdb"

endif
```

## configs/P2010RDB_NAND_defconfig
```kconfig
CONFIG_SPL=y
CONFIG_TPL=y
CONFIG_SYS_EXTRA_OPTIONS="P2010RDB,NAND"
CONFIG_PPC=y
CONFIG_MPC85xx=y
CONFIG_TARGET_P1_P2_RDB=y
```
